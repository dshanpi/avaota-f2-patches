## source/device/config/chips/v861/configs/avaota_f2/linux-6.6-xuantie/bsp_defconfig
```kconfig
CONFIG_AW_BSP=y
CONFIG_AW_KERNEL_ORIGIN=y
CONFIG_ARCH_SUN252I=y
CONFIG_AW_IC_BOARD=y
CONFIG_AW_SOC_NAME="V861"
# CONFIG_AW_DDR_CCU is not set
# CONFIG_AW_UART is not set
CONFIG_AW_UART_NG=y
CONFIG_AW_SERIAL_CONSOLE=y
CONFIG_AW_SERLAL_NR_UARTS=4
CONFIG_AW_TIMER_SUN50I=y
# CONFIG_AW_TIMER_DYNAMIC_DEBUG is not set
CONFIG_AW_TIMER_SWAP_IVH_CVL_SPACE=y
CONFIG_AW_DMA=y
CONFIG_AW_RTC=y
CONFIG_AW_RTC_REBOOT_FLAG=y
CONFIG_AW_RTC_POWEROFF_ALARM=y
CONFIG_AW_WATCHDOG=y
CONFIG_AW_MBUS_GENERIC=y
CONFIG_AW_MMC_HSQ=y
CONFIG_AW_MMC=y
CONFIG_AW_MTD=y
CONFIG_AW_MTD_SUNXI_PARTS=y
# CONFIG_AW_MTD_SPI_NOR_USE_4K_SECTORS is not set
CONFIG_AW_MTD_SPI_NOR_6_1=y
CONFIG_SPIF_SUNXI=y
CONFIG_AW_G2D=y
CONFIG_G2D200=y
CONFIG_AW_VIDEO_SUNXI_VIN=m
CONFIG_AW_SUBDEV_SUNXI_VIN=m
CONFIG_ENABLE_SENSOR_FLIP_OPTION=y
# CONFIG_FLASH is not set
# CONFIG_SENSOR_LIST is not set
CONFIG_VIN_USE_ION_SIZE_POOL_HEAP=y
CONFIG_VIN_DMA_OPS=y
CONFIG_SUPPORT_ISP_TDM=y
CONFIG_TDM_LBC_EN=y
CONFIG_FRAMEDONE_TWO_BUFFER=y
CONFIG_D3D=y
CONFIG_D3D_LBC_MODE=y
CONFIG_D3D_COMPRESS_EN=y
# CONFIG_SAME_I2C is not set
CONFIG_SENSOR_OV13850=m
CONFIG_SND_SOC_SUNXI_DEBUG=y
CONFIG_SND_SOC_SUNXI_AAUDIO=y
CONFIG_SND_SOC_SUNXI_I2S=y
CONFIG_SND_SOC_SUNXI_COMPONENTS=y
CONFIG_AW_SYS_INFO=y
CONFIG_AW_SBI=y
CONFIG_AW_SID_V2=y
CONFIG_AW_GMAC=y
CONFIG_USB_EHCI_HCD_SUNXI=y
CONFIG_USB_OHCI_HCD_SUNXI=y
CONFIG_USB_SUNXI_HCD=y
CONFIG_USB_SUNXI_HCI=y
CONFIG_USB_SUNXI_EHCI0=y
CONFIG_USB_SUNXI_OHCI0=y
CONFIG_USB_SUNXI_USB=y
CONFIG_USB_SUNXI_USB_MANAGER=y
CONFIG_USB_SUNXI_USB_DEBUG=y
CONFIG_USB_SUNXI_USB_ADB=y
CONFIG_USB_SUNXI_UDC0=y
CONFIG_AW_TWI=y
CONFIG_AW_SPI_NG=y
CONFIG_AW_PWM=y
CONFIG_AW_GPADC=y
# CONFIG_AW_INPUT_SENSORINIT is not set
CONFIG_AW_AC300_EPHY=y
CONFIG_AW_SIFIVE_PLIC=y
CONFIG_AW_STANDBY_PM_PARAM=y
# CONFIG_AW_STANDBY_PM_MSGBOX_DRAM_REFRESH_OPS is not set
# CONFIG_AW_STANDBY_PM_MSGBOX_SRAM_SUSPEND_OPS is not set
CONFIG_AW_STANDBY_PM_MSGBOX_AOV_TIMER_OPS=y
CONFIG_AW_THERMAL=y
CONFIG_AW_THS_GPADC_GET_TEMP=y
CONFIG_AW_MFD_AXP2101_I2C=y
CONFIG_AW_REGULATOR_AXP2101=y
CONFIG_AW_CPUFREQ_DT=y
CONFIG_ARM_AW_SUN50I_CPUFREQ_NVMEM=y
CONFIG_AW_MSGBOX=y
CONFIG_AW_HWSPINLOCK=y
CONFIG_AW_REMOTEPROC=y
CONFIG_AW_RPROC_SUBDEV=y
CONFIG_AW_RPROC_SUBDEV_WDT=y
CONFIG_SUNXI_RPROC_SHARE_IRQ=y
CONFIG_AW_REMOTEPROC_E907_BOOT=y
CONFIG_AW_REMOTEPROC_IGNORE_KERNEL_REQUEST_FW=y
CONFIG_AW_RPMSG_CTRL=y
# CONFIG_AW_RPMSG_CLASS is not set
CONFIG_AW_NNA_SUNXI=y
CONFIG_AW_DMABUF_HEAPS_SIZE_POOL=y
# CONFIG_LOCALVERSION_AUTO is not set
CONFIG_SYSVIPC=y
CONFIG_NO_HZ_IDLE=y
CONFIG_HIGH_RES_TIMERS=y
CONFIG_BPF_SYSCALL=y
CONFIG_IKCONFIG=y
CONFIG_IKCONFIG_PROC=y
CONFIG_CGROUPS=y
CONFIG_CGROUP_SCHED=y
CONFIG_CFS_BANDWIDTH=y
CONFIG_CGROUP_BPF=y
CONFIG_NAMESPACES=y
CONFIG_USER_NS=y
CONFIG_CHECKPOINT_RESTORE=y
CONFIG_EXPERT=y
CONFIG_NONPORTABLE=y
CONFIG_ARCH_RV32I=y
CONFIG_CMODEL_MEDANY=y
CONFIG_SMP=y
CONFIG_NR_CPUS=2
# CONFIG_EFI is not set
CONFIG_PM_DEBUG=y
CONFIG_ENERGY_MODEL=y
CONFIG_CPU_FREQ=y
CONFIG_CPU_FREQ_STAT=y
CONFIG_CPU_FREQ_GOV_POWERSAVE=y
CONFIG_CPU_FREQ_GOV_USERSPACE=y
CONFIG_CPU_FREQ_GOV_ONDEMAND=y
CONFIG_CPU_FREQ_GOV_CONSERVATIVE=y
CONFIG_CPU_FREQ_GOV_SCHEDUTIL=y
CONFIG_JUMP_LABEL=y
CONFIG_ARCH_MMAP_RND_BITS=17
# CONFIG_STRICT_KERNEL_RWX is not set
CONFIG_MODULES=y
CONFIG_MODULE_UNLOAD=y
CONFIG_CMA=y
CONFIG_NET=y
CONFIG_PACKET=y
CONFIG_UNIX=y
CONFIG_UNIX_DIAG=y
CONFIG_NET_KEY=y
CONFIG_INET=y
CONFIG_IP_MULTICAST=y
CONFIG_IP_ADVANCED_ROUTER=y
CONFIG_IP_FIB_TRIE_STATS=y
CONFIG_IP_MULTIPLE_TABLES=y
CONFIG_INET_IPCOMP=y
CONFIG_INET_UDP_DIAG=y
CONFIG_DEVTMPFS=y
CONFIG_DEVTMPFS_MOUNT=y
CONFIG_MTD=y
CONFIG_MTD_BLOCK=y
CONFIG_BLK_DEV_LOOP=y
CONFIG_VIRTIO_BLK=y
CONFIG_SCSI=y
CONFIG_BLK_DEV_SD=y
# CONFIG_INPUT_KEYBOARD is not set
# CONFIG_INPUT_MOUSE is not set
CONFIG_SERIO_LIBPS2=y
# CONFIG_LEGACY_PTYS is not set
# CONFIG_LEGACY_TIOCSTI is not set
# CONFIG_LDISC_AUTOLOAD is not set
CONFIG_VIRTIO_CONSOLE=m
# CONFIG_HW_RANDOM is not set
# CONFIG_PTP_1588_CLOCK is not set
CONFIG_POWER_SUPPLY=y
CONFIG_THERMAL_STATISTICS=y
CONFIG_THERMAL_EMERGENCY_POWEROFF_DELAY_MS=10000
CONFIG_THERMAL_WRITABLE_TRIPS=y
CONFIG_THERMAL_DEFAULT_GOV_POWER_ALLOCATOR=y
CONFIG_THERMAL_GOV_FAIR_SHARE=y
CONFIG_THERMAL_GOV_STEP_WISE=y
CONFIG_THERMAL_GOV_BANG_BANG=y
CONFIG_THERMAL_GOV_USER_SPACE=y
CONFIG_THERMAL_GOV_POWER_ALLOCATOR=y
CONFIG_CPU_THERMAL=y
CONFIG_THERMAL_EMULATION=y
CONFIG_MFD_SUN6I_PRCM=y
CONFIG_MFD_SYSCON=y
CONFIG_REGULATOR_FIXED_VOLTAGE=y
# CONFIG_MEDIA_CEC_SUPPORT is not set
CONFIG_MEDIA_SUPPORT=y
# CONFIG_DVB_CORE is not set
# CONFIG_RADIO_ADAPTERS is not set
# CONFIG_MEDIA_PLATFORM_DRIVERS is not set
# CONFIG_VIDEO_CAMERA_SENSOR is not set
# CONFIG_MEDIA_TUNER_E4000 is not set
# CONFIG_MEDIA_TUNER_FC0011 is not set
# CONFIG_MEDIA_TUNER_FC0012 is not set
# CONFIG_MEDIA_TUNER_FC0013 is not set
# CONFIG_MEDIA_TUNER_FC2580 is not set
# CONFIG_MEDIA_TUNER_IT913X is not set
# CONFIG_MEDIA_TUNER_M88RS6000T is not set
# CONFIG_MEDIA_TUNER_MAX2165 is not set
# CONFIG_MEDIA_TUNER_MC44S803 is not set
# CONFIG_MEDIA_TUNER_MSI001 is not set
# CONFIG_MEDIA_TUNER_MT2060 is not set
# CONFIG_MEDIA_TUNER_MT2063 is not set
# CONFIG_MEDIA_TUNER_MT20XX is not set
# CONFIG_MEDIA_TUNER_MT2131 is not set
# CONFIG_MEDIA_TUNER_MT2266 is not set
# CONFIG_MEDIA_TUNER_MXL301RF is not set
# CONFIG_MEDIA_TUNER_MXL5005S is not set
# CONFIG_MEDIA_TUNER_MXL5007T is not set
# CONFIG_MEDIA_TUNER_QM1D1B0004 is not set
# CONFIG_MEDIA_TUNER_QM1D1C0042 is not set
# CONFIG_MEDIA_TUNER_QT1010 is not set
# CONFIG_MEDIA_TUNER_R820T is not set
# CONFIG_MEDIA_TUNER_SI2157 is not set
# CONFIG_MEDIA_TUNER_SIMPLE is not set
# CONFIG_MEDIA_TUNER_TDA18212 is not set
# CONFIG_MEDIA_TUNER_TDA18218 is not set
# CONFIG_MEDIA_TUNER_TDA18250 is not set
# CONFIG_MEDIA_TUNER_TDA18271 is not set
# CONFIG_MEDIA_TUNER_TDA827X is not set
# CONFIG_MEDIA_TUNER_TDA8290 is not set
# CONFIG_MEDIA_TUNER_TDA9887 is not set
# CONFIG_MEDIA_TUNER_TEA5761 is not set
# CONFIG_MEDIA_TUNER_TEA5767 is not set
# CONFIG_MEDIA_TUNER_TUA9001 is not set
# CONFIG_MEDIA_TUNER_XC2028 is not set
# CONFIG_MEDIA_TUNER_XC4000 is not set
# CONFIG_MEDIA_TUNER_XC5000 is not set
CONFIG_FB=y
CONFIG_BACKLIGHT_CLASS_DEVICE=y
CONFIG_SOUND=y
CONFIG_SND=y
CONFIG_SND_SOC=y
CONFIG_USB=y
CONFIG_USB_ANNOUNCE_NEW_DEVICES=y
CONFIG_USB_EHCI_HCD=y
CONFIG_USB_OHCI_HCD=y
CONFIG_USB_STORAGE=y
CONFIG_USB_STORAGE_REALTEK=y
CONFIG_USB_STORAGE_DATAFAB=y
CONFIG_USB_STORAGE_FREECOM=y
CONFIG_USB_STORAGE_ISD200=y
CONFIG_USB_STORAGE_USBAT=y
CONFIG_USB_STORAGE_SDDR09=y
CONFIG_USB_STORAGE_SDDR55=y
CONFIG_USB_STORAGE_JUMPSHOT=y
CONFIG_USB_STORAGE_ALAUDA=y
CONFIG_USB_STORAGE_ONETOUCH=y
CONFIG_USB_STORAGE_KARMA=y
CONFIG_USB_STORAGE_CYPRESS_ATACB=y
CONFIG_USB_STORAGE_ENE_UB6250=y
CONFIG_USB_UAS=y
CONFIG_USB_GADGET=y
CONFIG_USB_CONFIGFS=y
CONFIG_USB_CONFIGFS_MASS_STORAGE=y
CONFIG_USB_CONFIGFS_F_FS=y
CONFIG_USB_ROLE_SWITCH=y
CONFIG_MMC=y
CONFIG_SYNC_FILE=y
CONFIG_DMABUF_HEAPS=y
CONFIG_DMABUF_HEAPS_SYSTEM=y
CONFIG_DMABUF_HEAPS_CMA=y
# CONFIG_VIRTIO_MENU is not set
# CONFIG_SUNXI_CCU is not set
# CONFIG_IOMMU_SUPPORT is not set
CONFIG_IIO=y
CONFIG_IIO_SW_DEVICE=y
CONFIG_EXT4_FS=y
CONFIG_EXT4_FS_POSIX_ACL=y
CONFIG_OVERLAY_FS=y
CONFIG_MSDOS_FS=y
CONFIG_VFAT_FS=y
CONFIG_EXFAT_FS=y
CONFIG_TMPFS=y
CONFIG_TMPFS_POSIX_ACL=y
CONFIG_JFFS2_FS=y
CONFIG_SQUASHFS=y
# CONFIG_SQUASHFS_ZLIB is not set
CONFIG_SQUASHFS_XZ=y
CONFIG_NLS_CODEPAGE_437=y
CONFIG_NLS_ISO8859_1=y
CONFIG_CRYPTO_DEV_VIRTIO=y
CONFIG_CRC_ITU_T=y
CONFIG_CRC7=y
# CONFIG_XZ_DEC_X86 is not set
# CONFIG_XZ_DEC_POWERPC is not set
# CONFIG_XZ_DEC_ARM is not set
# CONFIG_XZ_DEC_ARMTHUMB is not set
# CONFIG_XZ_DEC_ARM64 is not set
# CONFIG_XZ_DEC_SPARC is not set
CONFIG_DMA_CMA=y
CONFIG_PRINTK_TIME=y
CONFIG_DYNAMIC_DEBUG=y
CONFIG_FRAME_WARN=2048
# CONFIG_RCU_TRACE is not set
```

## source/openwrt/package/allwinner/vision/libAWIspApi/machinfo/v861/Config.in
```kconfig
menu "Select libisp configuration options"
depends on PACKAGE_libAWIspApi

choice
	prompt "Select compile libisp to static or dynamic library"
	depends on PACKAGE_libAWIspApi
	default libisp_compile_static_lib

config libisp_compile_static_lib
	bool "compile static lib"
	help
	  compile static libs for libisp.

config libisp_compile_dynamic_lib
	bool "compile dynamic lib"
	help
	  compile dynamic lib for libisp.

endchoice

config libisp_build_libispapi
	bool "libisp build and install libawispapi for 3rd apps"
	depends on PACKAGE_libAWIspApi
	default n
	help
	  libisp build and install libawispapi for 3rd apps

config libisp_build_tunning_app
	bool "libisp build awTuningApps"
	depends on PACKAGE_libAWIspApi
	default n
	help
	  libisp build awTuningApp

config libisp_support_fastboot
	bool "libisp support fastboot"
	depends on PACKAGE_libAWIspApi
	default n
	help
	  libisp support fastboot.

config libisp_software_tdm
	bool "libisp support software tdm"
	depends on PACKAGE_libAWIspApi
	default n
	help
	  libisp support software tdm

config libisp_enable_systrace
	bool "libisp enable systrace"
	depends on PACKAGE_libAWIspApi
	default n
	help
	  libisp enable systrace

config libisp_disable_af
	bool "libisp disable af"
	depends on PACKAGE_libAWIspApi
	default n
	help
	  libisp disable af

config libisp_use_ini_cfg
	bool "libisp use ini cfg"
	depends on PACKAGE_libAWIspApi
	default n
	help
	  libisp use ini cfg

config libisp_select_sensor
	bool "Select ISP Sensor Tuning Config"
	depends on PACKAGE_libAWIspApi
	default y
	help
	  tell eyesee-mpp-middleware the used sensor type.
	  multiple sensors can be selected in multiple mipi scenarios.

config cv2003
	bool "use sensor cv2003"
	depends on libisp_select_sensor
	default n
	help
	  cv2003 is for ipc.

config gc1084
	bool "use sensor gc1084"
	depends on libisp_select_sensor
	default n
	help
	  gc1084 is for ipc.

config imx258
	bool "use sensor imx258"
	depends on libisp_select_sensor
	default n
	help
	  imx258 is for ipc.

config gc2053
	bool "use sensor gc2053"
	depends on libisp_select_sensor
	default y
	help
	  gc2053 is for ipc.

config ov13850
	bool "use sensor ov13850"
	depends on libisp_select_sensor
	default n
	help
	  OV13850 2560x1440 ISP610 vendor tuning.

config gc2083
	bool "use sensor gc2083"
	depends on libisp_select_sensor
	default n
	help
	  gc2083 is for ipc.

config gc4663
	bool "use sensor gc4663"
	depends on libisp_select_sensor
	default n
	help
	  gc4663 is for ipc.

config gc8613
	bool "use sensor gc8613"
	depends on libisp_select_sensor
	default n
	help
	  gc8613 is for ipc.

config f37p
	bool "use sensor f37p"
	depends on libisp_select_sensor
	default n
	help
	  f37p is for ipc.

config sc2336
	bool "use sensor sc2336"
	depends on libisp_select_sensor
	default n
	help
	  sc2336 is for ipc.

config sc2337p
	bool "use sensor sc2337p"
	depends on libisp_select_sensor
	default n
	help
	  sc2337p is for ipc.

config sc3336
	bool "use sensor sc3336"
	depends on libisp_select_sensor
	default n
	help
	  sc3336 is for ipc.

config sc1346
	bool "use sensor sc1346"
	depends on libisp_select_sensor
	default n
	help
	  sc1346 is for ipc.

config sc200ai
	bool "use sensor sc200ai"
	depends on libisp_select_sensor
	default n
	help
	  sc200ai is for ipc.

config sc231hai
	bool "use sensor sc231hai"
	depends on libisp_select_sensor
	default n
	help
	  sc231hai is for ipc.

config sc235hai
	bool "use sensor sc235hai"
	depends on libisp_select_sensor
	default n
	help
	  sc235hai is for ipc.

config sc485sl
	bool "use sensor sc485sl"
	depends on libisp_select_sensor
	default n
	help
	  sc485sl is for ipc.

config sc635hai
	bool "use sensor sc635hai"
	depends on libisp_select_sensor
	default n
	help
	  sc635hai is for ipc.

config os02g10
	bool "use sensor os02g10"
	depends on libisp_select_sensor
	default n
	help
	  os02g10 is for ipc.

config bf2257cs
	bool "use sensor bf2257cs"
	depends on libisp_select_sensor
	default n
	help
	  bf2257cs is for ipc.

config cv8002
	bool "use sensor cv8002"
	depends on libisp_select_sensor
	default n
	help
	  cv8002 is for ipc.

config sc533hai
	bool "use sensor sc533hai"
	depends on libisp_select_sensor
	default n
	help
	  sc533hai is for ipc.

config cv2005
	bool "use sensor cv2005"
	depends on libisp_select_sensor
	default n
	help
	  cv2005 is for ipc.

config cv5003
	bool "use sensor cv5003"
	depends on libisp_select_sensor
	default n
	help
	  cv5003 is for ipc.

config imx681
	bool "use sensor imx681"
	depends on libisp_select_sensor
	default n
	help
	  imx681 is for ipc.

config imx766
	bool "use sensor imx766"
	depends on libisp_select_sensor
	default n
	help
	  imx766 is for ipc.

config gc13a2
	bool "use sensor gc13a2"
	depends on libisp_select_sensor
	default n
	help
	  gc13a2 is for ipc.

endmenu
```
